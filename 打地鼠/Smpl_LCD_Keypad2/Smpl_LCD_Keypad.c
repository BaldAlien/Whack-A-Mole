/*---------------------------------------------------------------------------------------------------------*/
/*                                                                                                         */
/* Sample Code : Smpl_7seg_Keypad                                                                          */
/*               input  : 3x3 Keypad   																       */
/*               output : 7-segment display			                 							  	       */
/*                                                                                                         */
/*---------------------------------------------------------------------------------------------------------*/
#include <stdio.h>
#include <stdlib.h>
#include <string.h>
#include "NUC1xx.h"
#include "Seven_Segment.h"
#include "scankey.h"
#include "LCD_Driver.h"
#define BAUDRATE 9600

unsigned char DisplayBuf[8 * 128];
8
unsigned char Img_mole_nor[40 * 4] = {
	0x00,0x00,0x00,0x00,0x00,0x00,0x00,0x00,0x00,0x00,0x00,0xE0,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0x00,
	0x00,0x00,0x00,0x00,0x00,0x00,0x00,0x00,0x00,0x00,0x00,0xC0,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0x00,
	0x00,0x00,0x80,0x80,0xC0,0x40,0x60,0x60,0x20,0x60,0x20,0xFF,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0x00,
	0x00,0x00,0x03,0x03,0x06,0x06,0x04,0x0C,0x0C,0x0C,0x08,0x1D,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0x00
};

unsigned char Img_mole_die[40 * 4] = {
	0x00,0x00,0x00,0x00,0x50,0x68,0x88,0x84,0x04,0x02,0x04,0xE0,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0x00,
	0x00,0x00,0x00,0x00,0x00,0x00,0x00,0x00,0x00,0x00,0x00,0xA1,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0x00,
	0x00,0x00,0x80,0x80,0xC0,0x40,0x60,0x60,0x60,0x60,0x20,0xFF,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0x00,
	0x00,0x00,0x03,0x03,0x06,0x04,0x04,0x0C,0x0C,0x08,0x18,0x1D,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0x00
};

unsigned char Img_mole_hole[40 * 4] = {
	0x00,0x00,0x00,0x00,0x00,0x00,0x00,0x00,0x00,0x00,0x00,0x00,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0x00,
	0x00,0x00,0x00,0x00,0x00,0x00,0x00,0x00,0x00,0x00,0x00,0x00,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0x00,
	0x00,0x00,0x80,0x80,0xC0,0x40,0x60,0x60,0x20,0x60,0x20,0x70,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0x00,
	0x00,0x00,0x03,0x03,0x06,0x06,0x04,0x0C,0x0C,0x0C,0x08,0x1C,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0x00
};

unsigned char Nuvoton[128 * 8] = {
	0x00, 0x00, 0x00, 0x00, 0x00, 0x00, 0x00, 0x00, 0x00, 0x00, 0x00, 0xE0,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 0x00,
	0x00, 0x00, 0x00, 0x00, 0x00, 0x00, 0x00, 0x00, 0x00, 0x00, 0x00, 0xC0,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 0x00,
	0x00, 0x00, 0x80, 0x80, 0xC0, 0x40, 0x60, 0x60, 0x20, 0x60, 0x20, 0xFF,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 0x00,
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	0x00, 0x00, 0x00, 0x00, 0x00, 0x00, 0x00, 0x00, 0x00, 0x00, 0x00, 0x00,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 0x00
};


void InitData(void);
void Delay(int32_t count);
int8_t GetRand(void);
void LoadBuf(void);
void LoadImg(uint8_t Img_num, uint8_t Img_location);


void InitData(void)
{
	uint8_t i;
	for (i = 0; i < 128 * 8; i++)
	{
		Nuvoton[i] = 0x00;
	}
	for (i = 1; i <= 6; i++)
	{
		LoadImg(0, i);
	}
}
// void InitMoleHole(void)
// {
// 	uint8_t i;
// 	for (i = 1; i <= 6; i++)
// 	{
// 		LoadImg(0, i);
// 	}
// }
void Delay(int32_t count)
{
	while (count--)
	{
		//		__NOP;
	}
}
int8_t GetRand(void)
{
	return rand() % 6 + 1;
}
void LoadBuf(void)
{
	uint8_t x, y;
	for (y = 0; y < 128; y++)
	{
		for (x = 0; x < 8; x++)
		{
			DisplayBuf[y * 8 + x] = Nuvoton[y + x * 128];
		}
	}
}
void LoadImg(uint8_t Img_num, uint8_t Img_location)
{
	uint8_t x, y;

	switch (Img_num)
	{
	case 0:
		for (y = 0; y < 4; y++)
		{
			for (x = 0; x < 40; x++)
			{
				Nuvoton[y * 128 + 128 * 4 * (Img_location / 4) + 40 * ((Img_location - 1) % 3) + 2 * ((Img_location - 1) % 3 + 1) + x] = Img_mole_hole[y * 40 + x];
			}
		}
		break;
	case 1:
		for (y = 0; y < 4; y++)
		{
			for (x = 0; x < 40; x++)
			{
				Nuvoton[y * 128 + 128 * 4 * (Img_location / 4) + 40 * ((Img_location - 1) % 3) + 2 * ((Img_location - 1) % 3 + 1) + x] = Img_mole_nor[y * 40 + x];
			}
		}
		break;
	case 2:
		for (y = 0; y < 4; y++)
		{
			for (x = 0; x < 40; x++)
			{
				Nuvoton[y * 128 + 128 * 4 * (Img_location / 4) + 40 * ((Img_location - 1) % 3) + 2 * ((Img_location - 1) % 3 + 1) + x] = Img_mole_die[y * 40 + x];
			}
		}
		break;
	default:
		break;
	}
}
/*----------------------------------------------------------------------------
  MAIN function
  ----------------------------------------------------------------------------*/
int32_t main(void)
{
	int8_t number;

	// char text[15]="Key =   ";
	// char mole_text[15] = "mole = ";
	// char whack_text[15] = "whack = ";
	// char res_text[15] = "res = ";

	int8_t mole_state = 1;		   //地鼠状态，1代表活的，0代表死的
	int32_t mole_rand_count = 100; //地鼠刷新计时器
	int8_t mole_now = 1;   //获得一只地鼠

	UNLOCKREG();
	SYSCLK->PWRCON.XTL32K_EN = 1;
	SYSCLK->PWRCON.XTL12M_EN = 1; //Enable 12Mhz and set HCLK->12Mhz
	SYSCLK->CLKSEL0.HCLK_S = 0;
	LOCKREG();

	Initial_panel();
	clr_all_panel();

	OpenKeyPad();

	InitData();
	while (1)
	{
		if (mole_rand_count) //判断地鼠是否要刷新
		{
			mole_rand_count--; //不用刷新，计数-1
		}
		else
		{
			LoadImg(0, mole_now);	//刷走上一只地鼠
			mole_now = GetRand();  //刷新地鼠
			// InitMoleHole();
			LoadImg(1, mole_now);
			mole_state = 1;		   //活的地鼠
			mole_rand_count = 100; //地鼠刷新时间重置
		}
		// mole_now = GetRand();
		number = Scankey(); //读取键盘

		if (mole_now == (number - 3)) //如果刚好打中当前地鼠
		{
			LoadImg(2, mole_now);		//地鼠变为死的
			mole_state = 0;
		}

		close_seven_segment();
		show_seven_segment(0, number); //数码管显示键盘输入

		// sprintf(mole_text + 7, "%d", mole_now);
		// sprintf(whack_text + 8, "%d", number);
		// if (mole_state)
		// {
		// 	sprintf(res_text + 6, "live");
		// }
		// else
		// {
		// 	sprintf(res_text + 6, "死 ");
		// }
		LoadBuf();
		// print_lcd(0, mole_text);
		// print_lcd(1, whack_text);
		// print_lcd(2, res_text);
		draw_LCD(DisplayBuf); // render to LCD
		Delay(5000);
	}
}
